## meta-raghav/conf/layer.conf
```bitbake
# We have a conf and classes directory, add to BBPATH
BBPATH .= ":${LAYERDIR}"

# We have recipes-* directories, add to BBFILES
BBFILES += "${LAYERDIR}/recipes-*/*/*.bb \
            ${LAYERDIR}/recipes-*/*/*.bbappend"

BBFILE_COLLECTIONS += "meta-raghav"
BBFILE_PATTERN_meta-raghav = "^${LAYERDIR}/"
BBFILE_PRIORITY_meta-raghav = "6"

LAYERDEPENDS_meta-raghav = "core"
LAYERSERIES_COMPAT_meta-raghav = "walnascar"
```
